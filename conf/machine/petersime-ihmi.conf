## conf/machine/petersime-ihmi.conf
```bitbake
#@TYPE: Machine
#@NAME: PeterSime iHMI
#@SOC: i.MX6S
#@DESCRIPTION: Machine configuration for PeterSime iHMI
#@MAINTAINER: Brecht Neyrinck <brecht.neyrinck@psicontrol.com>

require conf/machine/include/imx-base.inc
require conf/machine/include/tune-cortexa9.inc

SERIAL_CONSOLE = "115200 ttymxc0"

SOC_FAMILY = "mx6:mx6dl"

KERNEL_DEVICETREE = "hmi_board.dtb"

PREFERRED_PROVIDER_u-boot = "u-boot-psi"
PREFERRED_PROVIDER_virtual/bootloader = "u-boot-psi"
KERNEL_IMAGETYPE = "uImage"

IMAGE_EXTRA_INSTALL = "modprobe-blacklist fsl-rc-local vlan-scripts linuxtestlib mii-reg eGTouchD"
```
